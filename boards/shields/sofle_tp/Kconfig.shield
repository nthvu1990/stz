## boards/shields/sofle_tp/Kconfig.shield
```kconfig
# Copyright (c) 2020 Pete Johanson
# SPDX-License-Identifier: MIT

config SHIELD_SOFLE_TP_LEFT
	def_bool $(shields_list_contains,sofle_tp_left)

config SHIELD_SOFLE_TP_RIGHT
	def_bool $(shields_list_contains,sofle_tp_right)
```

## config/boards/shield/sofle/Kconfig.defconfig
```kconfig
if SHIELD_SOFLE_LEFT

config ZMK_KEYBOARD_NAME
	default "Sofle"

config ZMK_SPLIT_ROLE_CENTRAL
	default y

endif

if SHIELD_SOFLE_RIGHT || SHIELD_SOFLE_LEFT

config ZMK_SPLIT
	default y

endif
```
